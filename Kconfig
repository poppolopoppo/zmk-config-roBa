## Kconfig
```kconfig
config ZMK_BEHAVIOR_MOD_LAYER
	bool "Enable mod-layer behavior"
	default y
	depends on DT_HAS_ZMK_BEHAVIOR_MOD_LAYER_ENABLED
```

## dts/bindings/behaviors/roba,behavior-host-os.yaml
```yaml
description: Select the host OS used by RoBa shortcuts and accent macros (0 Linux, 1 Windows, 2 toggle)
compatible: "roba,behavior-host-os"
include: one_param.yaml
```

## dts/bindings/behaviors/roba,behavior-os-select.yaml
```yaml
description: Dispatch to Linux or Windows behavior according to the selected host OS
compatible: "roba,behavior-os-select"
include: zero_param.yaml
properties:
  bindings:
    type: phandle-array
    required: true
    description: Two zero-parameter behaviors, Linux first and Windows second
```

## dts/bindings/behaviors/zmk,behavior-mod-layer.yaml
```yaml
# Copyright (c) 2026 The ZMK Contributors
# SPDX-License-Identifier: MIT

description: |
  Modifier combined with a momentary layer (QMK LM() equivalent).

  On press: synchronously presses the modifier keycode and activates the layer.
  On release: deactivates the layer and releases the modifier.

  Binding parameters:
    param1 = layer index (applied to the first `bindings` entry, e.g. &mo)
    param2 = keycode     (applied to the second `bindings` entry, e.g. &kp)

compatible: "zmk,behavior-mod-layer"

include: two_param.yaml

properties:
  bindings:
    type: phandles
    required: true
```
